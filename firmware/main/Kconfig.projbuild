## firmware/main/Kconfig.projbuild
```kconfig
menu "ADAM hardware"
    config ADAM_BOARD_146
        bool "Waveshare ESP32-S3-Touch-LCD-1.46 (SPD2010 / PCM5101 / digital microphone)"
        default n
        help
            Leave disabled for the original 1.85C BOX V2. These boards use
            different audio wiring and display/touch controllers.
endmenu

menu "ADAM voice capture"
    config ADAM_ENDPOINT_SILENCE_MS
        int "Quiet time before ending a wake command (milliseconds)"
        range 600 1500
        default 750
        help
            Increase to 1200 to restore the previous pause tolerance.
            Capture ends on a complete 20 ms packet.
endmenu
```

## firmware/sdkconfig.defaults
```kconfig
CONFIG_IDF_TARGET="esp32s3"
CONFIG_ESPTOOLPY_FLASHSIZE_16MB=y
CONFIG_ESPTOOLPY_FLASHMODE_DIO=y
CONFIG_ESP_CONSOLE_USB_SERIAL_JTAG=y
CONFIG_ESP_CONSOLE_SECONDARY_NONE=y
CONFIG_PARTITION_TABLE_CUSTOM=y
CONFIG_PARTITION_TABLE_CUSTOM_FILENAME="partitions.csv"
CONFIG_ESP_MAIN_TASK_STACK_SIZE=6144
# Headroom for DHCP/IP event handling and native USB console logging.
CONFIG_ESP_SYSTEM_EVENT_TASK_STACK_SIZE=6144
CONFIG_SPIRAM=y
CONFIG_SPIRAM_MODE_OCT=y
CONFIG_SPIRAM_SPEED_80M=y
CONFIG_SPIRAM_USE_MALLOC=y
CONFIG_ESP_DEFAULT_CPU_FREQ_MHZ_240=y
CONFIG_FREERTOS_HZ=1000
CONFIG_FREERTOS_GENERATE_RUN_TIME_STATS=y
CONFIG_FREERTOS_RUN_TIME_STATS_USING_ESP_TIMER=y
CONFIG_FREERTOS_RUN_TIME_COUNTER_TYPE_U64=y
```
